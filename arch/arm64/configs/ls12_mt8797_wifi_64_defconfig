## drivers/clk/mediatek/Kconfig
```kconfig
# SPDX-License-Identifier: GPL-2.0-only
#
# MediaTek Clock Drivers
#
menu "Clock driver for MediaTek SoC"
	depends on ARCH_MEDIATEK || COMPILE_TEST

config COMMON_CLK_MEDIATEK
	bool
	select RESET_CONTROLLER
	help
	  MediaTek SoCs' clock support.

config COMMON_CLK_MT2701
	bool "Clock driver for MediaTek MT2701"
	depends on (ARCH_MEDIATEK && ARM) || COMPILE_TEST
	select COMMON_CLK_MEDIATEK
	default ARCH_MEDIATEK && ARM
	help
	  This driver supports MediaTek MT2701 basic clocks.

config COMMON_CLK_MT2701_MMSYS
	bool "Clock driver for MediaTek MT2701 mmsys"
	depends on COMMON_CLK_MT2701
	help
	  This driver supports MediaTek MT2701 mmsys clocks.

config COMMON_CLK_MT2701_IMGSYS
	bool "Clock driver for MediaTek MT2701 imgsys"
	depends on COMMON_CLK_MT2701
	help
	  This driver supports MediaTek MT2701 imgsys clocks.

config COMMON_CLK_MT2701_VDECSYS
	bool "Clock driver for MediaTek MT2701 vdecsys"
	depends on COMMON_CLK_MT2701
	help
	  This driver supports MediaTek MT2701 vdecsys clocks.

config COMMON_CLK_MT2701_HIFSYS
	bool "Clock driver for MediaTek MT2701 hifsys"
	depends on COMMON_CLK_MT2701
	help
	  This driver supports MediaTek MT2701 hifsys clocks.

config COMMON_CLK_MT2701_ETHSYS
	bool "Clock driver for MediaTek MT2701 ethsys"
	depends on COMMON_CLK_MT2701
	help
	  This driver supports MediaTek MT2701 ethsys clocks.

config COMMON_CLK_MT2701_BDPSYS
	bool "Clock driver for MediaTek MT2701 bdpsys"
	depends on COMMON_CLK_MT2701
	help
	  This driver supports MediaTek MT2701 bdpsys clocks.

config COMMON_CLK_MT2701_AUDSYS
	bool "Clock driver for Mediatek MT2701 audsys"
	depends on COMMON_CLK_MT2701
	help
	  This driver supports Mediatek MT2701 audsys clocks.

config COMMON_CLK_MT2701_G3DSYS
	bool "Clock driver for MediaTek MT2701 g3dsys"
	depends on COMMON_CLK_MT2701
	help
	  This driver supports MediaTek MT2701 g3dsys clocks.

config COMMON_CLK_MT2712
	bool "Clock driver for MediaTek MT2712"
	depends on (ARCH_MEDIATEK && ARM64) || COMPILE_TEST
	select COMMON_CLK_MEDIATEK
	default ARCH_MEDIATEK && ARM64
	help
	  This driver supports MediaTek MT2712 basic clocks.

config COMMON_CLK_MT2712_BDPSYS
	bool "Clock driver for MediaTek MT2712 bdpsys"
	depends on COMMON_CLK_MT2712
	help
	  This driver supports MediaTek MT2712 bdpsys clocks.

config COMMON_CLK_MT2712_IMGSYS
	bool "Clock driver for MediaTek MT2712 imgsys"
	depends on COMMON_CLK_MT2712
	help
	  This driver supports MediaTek MT2712 imgsys clocks.

config COMMON_CLK_MT2712_JPGDECSYS
	bool "Clock driver for MediaTek MT2712 jpgdecsys"
	depends on COMMON_CLK_MT2712
	help
	  This driver supports MediaTek MT2712 jpgdecsys clocks.

config COMMON_CLK_MT2712_MFGCFG
	bool "Clock driver for MediaTek MT2712 mfgcfg"
	depends on COMMON_CLK_MT2712
	help
	  This driver supports MediaTek MT2712 mfgcfg clocks.

config COMMON_CLK_MT2712_MMSYS
	bool "Clock driver for MediaTek MT2712 mmsys"
	depends on COMMON_CLK_MT2712
	help
	  This driver supports MediaTek MT2712 mmsys clocks.

config COMMON_CLK_MT2712_VDECSYS
	bool "Clock driver for MediaTek MT2712 vdecsys"
	depends on COMMON_CLK_MT2712
	help
	  This driver supports MediaTek MT2712 vdecsys clocks.

config COMMON_CLK_MT2712_VENCSYS
	bool "Clock driver for MediaTek MT2712 vencsys"
	depends on COMMON_CLK_MT2712
	help
	  This driver supports MediaTek MT2712 vencsys clocks.

config COMMON_CLK_MT6765
       bool "Clock driver for MediaTek MT6765"
       depends on (ARCH_MEDIATEK && ARM64) || COMPILE_TEST
       select COMMON_CLK_MEDIATEK
       default ARCH_MEDIATEK && ARM64
       help
         This driver supports MediaTek MT6765 basic clocks.

config COMMON_CLK_MT6765_AUDIOSYS
       bool "Clock driver for MediaTek MT6765 audiosys"
       depends on COMMON_CLK_MT6765
       help
         This driver supports MediaTek MT6765 audiosys clocks.

config COMMON_CLK_MT6765_CAMSYS
       bool "Clock driver for MediaTek MT6765 camsys"
       depends on COMMON_CLK_MT6765
       help
         This driver supports MediaTek MT6765 camsys clocks.

config COMMON_CLK_MT6765_GCESYS
       bool "Clock driver for MediaTek MT6765 gcesys"
       depends on COMMON_CLK_MT6765
       help
         This driver supports MediaTek MT6765 gcesys clocks.

config COMMON_CLK_MT6765_MMSYS
       bool "Clock driver for MediaTek MT6765 mmsys"
       depends on COMMON_CLK_MT6765
       help
         This driver supports MediaTek MT6765 mmsys clocks.

config COMMON_CLK_MT6765_IMGSYS
       bool "Clock driver for MediaTek MT6765 imgsys"
       depends on COMMON_CLK_MT6765
       help
         This driver supports MediaTek MT6765 imgsys clocks.

config COMMON_CLK_MT6765_VCODECSYS
       bool "Clock driver for MediaTek MT6765 vcodecsys"
       depends on COMMON_CLK_MT6765
       help
         This driver supports MediaTek MT6765 vcodecsys clocks.

config COMMON_CLK_MT6765_MFGSYS
       bool "Clock driver for MediaTek MT6765 mfgsys"
       depends on COMMON_CLK_MT6765
       help
         This driver supports MediaTek MT6765 mfgsys clocks.

config COMMON_CLK_MT6765_MIPI0ASYS
       bool "Clock driver for MediaTek MT6765 mipi0asys"
       depends on COMMON_CLK_MT6765
       help
         This driver supports MediaTek MT6765 mipi0asys clocks.

config COMMON_CLK_MT6765_MIPI0BSYS
       bool "Clock driver for MediaTek MT6765 mipi0bsys"
       depends on COMMON_CLK_MT6765
       help
         This driver supports MediaTek MT6765 mipi0bsys clocks.

config COMMON_CLK_MT6765_MIPI1ASYS
       bool "Clock driver for MediaTek MT6765 mipi1asys"
       depends on COMMON_CLK_MT6765
       help
         This driver supports MediaTek MT6765 mipi1asys clocks.

config COMMON_CLK_MT6765_MIPI1BSYS
       bool "Clock driver for MediaTek MT6765 mipi1bsys"
       depends on COMMON_CLK_MT6765
       help
         This driver supports MediaTek MT6765 mipi1bsys clocks.

config COMMON_CLK_MT6765_MIPI2ASYS
       bool "Clock driver for MediaTek MT6765 mipi2asys"
       depends on COMMON_CLK_MT6765
      help
         This driver supports MediaTek MT6765 mipi2asys clocks.

config COMMON_CLK_MT6765_MIPI2BSYS
       bool "Clock driver for MediaTek MT6765 mipi2bsys"
       depends on COMMON_CLK_MT6765
       help
         This driver supports MediaTek MT6765 mipi2bsys clocks.

config COMMON_CLK_MT6779
	bool "Clock driver for MediaTek MT6779"
	depends on (ARCH_MEDIATEK && ARM64) || COMPILE_TEST
	select COMMON_CLK_MEDIATEK
	default ARCH_MEDIATEK && ARM64
	help
	  This driver supports MediaTek MT6779 basic clocks.

config COMMON_CLK_MT6779_MMSYS
	bool "Clock driver for MediaTek MT6779 mmsys"
	depends on COMMON_CLK_MT6779
	help
	  This driver supports MediaTek MT6779 mmsys clocks.

config COMMON_CLK_MT6779_IMGSYS
	bool "Clock driver for MediaTek MT6779 imgsys"
	depends on COMMON_CLK_MT6779
	help
	  This driver supports MediaTek MT6779 imgsys clocks.

config COMMON_CLK_MT6779_IPESYS
	bool "Clock driver for MediaTek MT6779 ipesys"
	depends on COMMON_CLK_MT6779
	help
	  This driver supports MediaTek MT6779 ipesys clocks.

config COMMON_CLK_MT6779_CAMSYS
	bool "Clock driver for MediaTek MT6779 camsys"
	depends on COMMON_CLK_MT6779
	help
	  This driver supports MediaTek MT6779 camsys clocks.

config COMMON_CLK_MT6779_VDECSYS
	bool "Clock driver for MediaTek MT6779 vdecsys"
	depends on COMMON_CLK_MT6779
	help
	  This driver supports MediaTek MT6779 vdecsys clocks.

config COMMON_CLK_MT6779_VENCSYS
	bool "Clock driver for MediaTek MT6779 vencsys"
	depends on COMMON_CLK_MT6779
	help
	  This driver supports MediaTek MT6779 vencsys clocks.

config COMMON_CLK_MT6779_MFGCFG
	bool "Clock driver for MediaTek MT6779 mfgcfg"
	depends on COMMON_CLK_MT6779
	help
	  This driver supports MediaTek MT6779 mfgcfg clocks.

config COMMON_CLK_MT6779_AUDSYS
	bool "Clock driver for Mediatek MT6779 audsys"
	depends on COMMON_CLK_MT6779
	help
	  This driver supports Mediatek MT6779 audsys clocks.

config COMMON_CLK_MT6797
	bool "Clock driver for MediaTek MT6797"
	depends on (ARCH_MEDIATEK && ARM64) || COMPILE_TEST
	select COMMON_CLK_MEDIATEK
	default ARCH_MEDIATEK && ARM64
	help
	  This driver supports MediaTek MT6797 basic clocks.

config COMMON_CLK_MT6797_MMSYS
	bool "Clock driver for MediaTek MT6797 mmsys"
	depends on COMMON_CLK_MT6797
	help
	  This driver supports MediaTek MT6797 mmsys clocks.

config COMMON_CLK_MT6797_IMGSYS
	bool "Clock driver for MediaTek MT6797 imgsys"
	depends on COMMON_CLK_MT6797
	help
	  This driver supports MediaTek MT6797 imgsys clocks.

config COMMON_CLK_MT6797_VDECSYS
	bool "Clock driver for MediaTek MT6797 vdecsys"
	depends on COMMON_CLK_MT6797
	help
	  This driver supports MediaTek MT6797 vdecsys clocks.

config COMMON_CLK_MT6797_VENCSYS
	bool "Clock driver for MediaTek MT6797 vencsys"
	depends on COMMON_CLK_MT6797
	help
	  This driver supports MediaTek MT6797 vencsys clocks.

config COMMON_CLK_MT7622
	bool "Clock driver for MediaTek MT7622"
	depends on ARCH_MEDIATEK || COMPILE_TEST
	select COMMON_CLK_MEDIATEK
	default ARCH_MEDIATEK
	help
	  This driver supports MediaTek MT7622 basic clocks and clocks
	  required for various periperals found on MediaTek.

config COMMON_CLK_MT7622_ETHSYS
	bool "Clock driver for MediaTek MT7622 ETHSYS"
	depends on COMMON_CLK_MT7622
	help
	  This driver add support for clocks for Ethernet and SGMII
	  required on MediaTek MT7622 SoC.

config COMMON_CLK_MT7622_HIFSYS
	bool "Clock driver for MediaTek MT7622 HIFSYS"
	depends on COMMON_CLK_MT7622
	help
	  This driver supports MediaTek MT7622 HIFSYS clocks providing
	  to PCI-E and USB.

config COMMON_CLK_MT7622_AUDSYS
	bool "Clock driver for MediaTek MT7622 AUDSYS"
	depends on COMMON_CLK_MT7622
	help
	  This driver supports MediaTek MT7622 AUDSYS clocks providing
	  to audio consumers such as I2S and TDM.

config COMMON_CLK_MT7629
	bool "Clock driver for MediaTek MT7629"
	depends on (ARCH_MEDIATEK && ARM) || COMPILE_TEST
	select COMMON_CLK_MEDIATEK
	default ARCH_MEDIATEK && ARM
	help
	  This driver supports MediaTek MT7629 basic clocks and clocks
	  required for various periperals found on MediaTek.

config COMMON_CLK_MT7629_ETHSYS
	bool "Clock driver for MediaTek MT7629 ETHSYS"
	depends on COMMON_CLK_MT7629
	help
	  This driver add support for clocks for Ethernet and SGMII
	  required on MediaTek MT7629 SoC.

config COMMON_CLK_MT7629_HIFSYS
	bool "Clock driver for MediaTek MT7629 HIFSYS"
	depends on COMMON_CLK_MT7629
	help
	  This driver supports MediaTek MT7629 HIFSYS clocks providing
	  to PCI-E and USB.

config COMMON_CLK_MT8135
	bool "Clock driver for MediaTek MT8135"
	depends on (ARCH_MEDIATEK && ARM) || COMPILE_TEST
	select COMMON_CLK_MEDIATEK
	default ARCH_MEDIATEK && ARM
	help
	  This driver supports MediaTek MT8135 clocks.

config COMMON_CLK_MT8167
	bool "Clock driver for MediaTek MT8167"
	depends on (ARCH_MEDIATEK && ARM64) || COMPILE_TEST
	select COMMON_CLK_MEDIATEK
	default ARCH_MEDIATEK
	help
	  This driver supports MediaTek MT8167 basic clocks.

config COMMON_CLK_MT8167_AUDSYS
	bool "Clock driver for MediaTek MT8167 audsys"
	depends on (ARCH_MEDIATEK && ARM64) || COMPILE_TEST
	select COMMON_CLK_MEDIATEK
	default ARCH_MEDIATEK
	help
	  This driver supports MediaTek MT8167 audsys clocks.

config COMMON_CLK_MT8167_IMGSYS
	bool "Clock driver for MediaTek MT8167 imgsys"
	depends on (ARCH_MEDIATEK && ARM64) || COMPILE_TEST
	select COMMON_CLK_MEDIATEK
	default ARCH_MEDIATEK
	help
	  This driver supports MediaTek MT8167 imgsys clocks.

config COMMON_CLK_MT8167_MFGCFG
	bool "Clock driver for MediaTek MT8167 mfgcfg"
	depends on (ARCH_MEDIATEK && ARM64) || COMPILE_TEST
	select COMMON_CLK_MEDIATEK
	default ARCH_MEDIATEK
	help
	  This driver supports MediaTek MT8167 mfgcfg clocks.

config COMMON_CLK_MT8167_MMSYS
	bool "Clock driver for MediaTek MT8167 mmsys"
	depends on (ARCH_MEDIATEK && ARM64) || COMPILE_TEST
	select COMMON_CLK_MEDIATEK
	default ARCH_MEDIATEK
	help
	  This driver supports MediaTek MT8167 mmsys clocks.

config COMMON_CLK_MT8167_VDECSYS
	bool "Clock driver for MediaTek MT8167 vdecsys"
	depends on (ARCH_MEDIATEK && ARM64) || COMPILE_TEST
	select COMMON_CLK_MEDIATEK
	default ARCH_MEDIATEK
	help
	  This driver supports MediaTek MT8167 vdecsys clocks.

config COMMON_CLK_MT8173
	bool "Clock driver for MediaTek MT8173"
	depends on ARCH_MEDIATEK || COMPILE_TEST
	select COMMON_CLK_MEDIATEK
	default ARCH_MEDIATEK
	help
	  This driver supports MediaTek MT8173 clocks.

config COMMON_CLK_MT8173_MMSYS
	bool "Clock driver for MediaTek MT8173 mmsys"
	depends on COMMON_CLK_MT8173
	default COMMON_CLK_MT8173
	help
	  This driver supports MediaTek MT8173 mmsys clocks.

config COMMON_CLK_MT8183
	bool "Clock driver for MediaTek MT8183"
	depends on (ARCH_MEDIATEK && ARM64) || COMPILE_TEST
	select COMMON_CLK_MEDIATEK
	default ARCH_MEDIATEK && ARM64
	help
	  This driver supports MediaTek MT8183 basic clocks.

config COMMON_CLK_MT8183_AUDIOSYS
	bool "Clock driver for MediaTek MT8183 audiosys"
	depends on COMMON_CLK_MT8183
	help
	  This driver supports MediaTek MT8183 audiosys clocks.

config COMMON_CLK_MT8183_CAMSYS
	bool "Clock driver for MediaTek MT8183 camsys"
	depends on COMMON_CLK_MT8183
	help
	  This driver supports MediaTek MT8183 camsys clocks.

config COMMON_CLK_MT8183_IMGSYS
	bool "Clock driver for MediaTek MT8183 imgsys"
	depends on COMMON_CLK_MT8183
	help
	  This driver supports MediaTek MT8183 imgsys clocks.

config COMMON_CLK_MT8183_IPU_CORE0
	bool "Clock driver for MediaTek MT8183 ipu_core0"
	depends on COMMON_CLK_MT8183
	help
	  This driver supports MediaTek MT8183 ipu_core0 clocks.

config COMMON_CLK_MT8183_IPU_CORE1
	bool "Clock driver for MediaTek MT8183 ipu_core1"
	depends on COMMON_CLK_MT8183
	help
	  This driver supports MediaTek MT8183 ipu_core1 clocks.

config COMMON_CLK_MT8183_IPU_ADL
	bool "Clock driver for MediaTek MT8183 ipu_adl"
	depends on COMMON_CLK_MT8183
	help
	  This driver supports MediaTek MT8183 ipu_adl clocks.

config COMMON_CLK_MT8183_IPU_CONN
	bool "Clock driver for MediaTek MT8183 ipu_conn"
	depends on COMMON_CLK_MT8183
	help
	  This driver supports MediaTek MT8183 ipu_conn clocks.

config COMMON_CLK_MT8183_MFGCFG
	bool "Clock driver for MediaTek MT8183 mfgcfg"
	depends on COMMON_CLK_MT8183
	help
	  This driver supports MediaTek MT8183 mfgcfg clocks.

config COMMON_CLK_MT8183_MMSYS
	bool "Clock driver for MediaTek MT8183 mmsys"
	depends on COMMON_CLK_MT8183
	help
	  This driver supports MediaTek MT8183 mmsys clocks.

config COMMON_CLK_MT8183_VDECSYS
	bool "Clock driver for MediaTek MT8183 vdecsys"
	depends on COMMON_CLK_MT8183
	help
	  This driver supports MediaTek MT8183 vdecsys clocks.

config COMMON_CLK_MT8183_VENCSYS
	bool "Clock driver for MediaTek MT8183 vencsys"
	depends on COMMON_CLK_MT8183
	help
	  This driver supports MediaTek MT8183 vencsys clocks.

config COMMON_CLK_MT8516
	bool "Clock driver for MediaTek MT8516"
	depends on ARCH_MEDIATEK || COMPILE_TEST
	select COMMON_CLK_MEDIATEK
	default ARCH_MEDIATEK
	help
	  This driver supports MediaTek MT8516 clocks.

config COMMON_CLK_MT8516_AUDSYS
	bool "Clock driver for MediaTek MT8516 audsys"
	depends on COMMON_CLK_MT8516
	help
	  This driver supports MediaTek MT8516 audsys clocks.

config COMMON_CLK_MT6893
	tristate "Clock driver for MediaTek MT6893"
	depends on ARCH_MEDIATEK || COMPILE_TEST
	select COMMON_CLK_MEDIATEK
	help
	  This driver supports MediaTek MT6893 basic clocks,
	  which is used to control basic clock output.
	  If you wish to use clock resources from the MT6893 SOC,
	  say Y. Otherwise, say N.

config COMMON_CLK_MT6893_APU0
	tristate "Clock driver for MediaTek MT6893 apu0"
	depends on COMMON_CLK_MT6893
	help
	  This driver supports MediaTek MT6893 apu0 clocks,
	  which is used to control apu0 clock output.
	  If you wish to use clock resources from the apu0 device,
	  say Y. Otherwise, say N.

config COMMON_CLK_MT6893_APU1
	tristate "Clock driver for MediaTek MT6893 apu1"
	depends on COMMON_CLK_MT6893
	help
	  This driver supports MediaTek MT6893 apu1 clocks,
	  which is used to control apu1 clock output.
	  If you wish to use clock resources from the apu1 device,
	  say Y. Otherwise, say N.

config COMMON_CLK_MT6893_APU2
	tristate "Clock driver for MediaTek MT6893 apu2"
	depends on COMMON_CLK_MT6893
	help
	  This driver supports MediaTek MT6893 apu2 clocks,
	  which is used to control apu2 clock output.
	  If you wish to use clock resources from the apu2 device,
	  say Y. Otherwise, say N.

config COMMON_CLK_MT6893_APU_VCORE
	tristate "Clock driver for MediaTek MT6893 apu_vcore"
	depends on COMMON_CLK_MT6893
	help
	  This driver supports MediaTek MT6893 apu_vcore clocks,
	  which is used to control apu_vcore clock output.
	  If you wish to use clock resources from the apu_vcore device,
	  say Y. Otherwise, say N.

config COMMON_CLK_MT6893_APU_CONN
	tristate "Clock driver for MediaTek MT6893 apu_conn"
	depends on COMMON_CLK_MT6893
	help
	  This driver supports MediaTek MT6893 apu_conn clocks,
	  which is used to control apu_conn clock output.
	  If you wish to use clock resources from the apu_conn device,
	  say Y. Otherwise, say N.

config COMMON_CLK_MT6893_APU_MDLA0
	tristate "Clock driver for MediaTek MT6893 apu_mdla0"
	depends on COMMON_CLK_MT6893
	help
	  This driver supports MediaTek MT6893 apu_mdla0 clocks,
	  which is used to control apu_mdla0 clock output.
	  If you wish to use clock resources from the apu_mdla0 device,
	  say Y. Otherwise, say N.

config COMMON_CLK_MT6893_APU_MDLA1
	tristate "Clock driver for MediaTek MT6893 apu_mdla1"
	depends on COMMON_CLK_MT6893
	help
	  This driver supports MediaTek MT6893 apu_mdla1 clocks,
	  which is used to control apu_mdla1 clock output.
	  If you wish to use clock resources from the apu_mdla1 device,
	  say Y. Otherwise, say N.

config COMMON_CLK_MT6893_AUDIOSYS
	tristate "Clock driver for MediaTek MT6893 audiosys"
	depends on COMMON_CLK_MT6893
	help
	  This driver supports MediaTek MT6893 audiosys clocks,
	  which is used to control audiosys clock output.
	  If you wish to use clock resources from the audiosys device,
	  say Y. Otherwise, say N.

config COMMON_CLK_MT6893_CAMSYS_MAIN
	tristate "Clock driver for MediaTek MT6893 camsys_main"
	depends on COMMON_CLK_MT6893
	help
	  This driver supports MediaTek MT6893 camsys_main clocks,
	  which is used to control camsys_main clock output.
	  If you wish to use clock resources from the camsys_main device,
	  say Y. Otherwise, say N.

config COMMON_CLK_MT6893_CAMSYS_RAWA
	tristate "Clock driver for MediaTek MT6893 camsys_rawa"
	depends on COMMON_CLK_MT6893
	help
	  This driver supports MediaTek MT6893 camsys_rawa clocks,
	  which is used to control camsys_rawa clock output.
	  If you wish to use clock resources from the camsys_rawa device,
	  say Y. Otherwise, say N.

config COMMON_CLK_MT6893_CAMSYS_RAWB
	tristate "Clock driver for MediaTek MT6893 camsys_rawb"
	depends on COMMON_CLK_MT6893
	help
	  This driver supports MediaTek MT6893 camsys_rawb clocks,
	  which is used to control camsys_rawb clock output.
	  If you wish to use clock resources from the camsys_rawb device,
	  say Y. Otherwise, say N.

config COMMON_CLK_MT6893_CAMSYS_RAWC
	tristate "Clock driver for MediaTek MT6893 camsys_rawc"
	depends on COMMON_CLK_MT6893
	help
	  This driver supports MediaTek MT6893 camsys_rawc clocks,
	  which is used to control camsys_rawc clock output.
	  If you wish to use clock resources from the camsys_rawc device,
	  say Y. Otherwise, say N.

config COMMON_CLK_MT6893_IMGSYS1
	tristate "Clock driver for MediaTek MT6893 imgsys1"
	depends on COMMON_CLK_MT6893
	help
	  This driver supports MediaTek MT6893 imgsys1 clocks,
	  which is used to control imgsys1 clock output.
	  If you wish to use clock resources from the imgsys1 device,
	  say Y. Otherwise, say N.

config COMMON_CLK_MT6893_IMGSYS2
	tristate "Clock driver for MediaTek MT6893 imgsys2"
	depends on COMMON_CLK_MT6893
	help
	  This driver supports MediaTek MT6893 imgsys2 clocks,
	  which is used to control imgsys2 clock output.
	  If you wish to use clock resources from the imgsys2 device,
	  say Y. Otherwise, say N.

config COMMON_CLK_MT6893_IMP_IIC_WRAP_C
	tristate "Clock driver for MediaTek MT6893 imp_iic_wrap_c"
	depends on COMMON_CLK_MT6893
	help
	  This driver supports MediaTek MT6893 imp_iic_wrap_c clocks,
	  which is used to control imp_iic_wrap_c clock output.
	  If you wish to use clock resources from the imp_iic_wrap_c device,
	  say Y. Otherwise, say N.

config COMMON_CLK_MT6893_IMP_IIC_WRAP_E
	tristate "Clock driver for MediaTek MT6893 imp_iic_wrap_e"
	depends on COMMON_CLK_MT6893
	help
	  This driver supports MediaTek MT6893 imp_iic_wrap_e clocks,
	  which is used to control imp_iic_wrap_e clock output.
	  If you wish to use clock resources from the imp_iic_wrap_e device,
	  say Y. Otherwise, say N.

config COMMON_CLK_MT6893_IMP_IIC_WRAP_N
	tristate "Clock driver for MediaTek MT6893 imp_iic_wrap_n"
	depends on COMMON_CLK_MT6893
	help
	  This driver supports MediaTek MT6893 imp_iic_wrap_n clocks,
	  which is used to control imp_iic_wrap_n clock output.
	  If you wish to use clock resources from the imp_iic_wrap_n device,
	  say Y. Otherwise, say N.

config COMMON_CLK_MT6893_IMP_IIC_WRAP_S
	tristate "Clock driver for MediaTek MT6893 imp_iic_wrap_s"
	depends on COMMON_CLK_MT6893
	help
	  This driver supports MediaTek MT6893 imp_iic_wrap_s clocks,
	  which is used to control imp_iic_wrap_s clock output.
	  If you wish to use clock resources from the imp_iic_wrap_s device,
	  say Y. Otherwise, say N.

config COMMON_CLK_MT6893_IPESYS
	tristate "Clock driver for MediaTek MT6893 ipesys"
	depends on COMMON_CLK_MT6893
	help
	  This driver supports MediaTek MT6893 ipesys clocks,
	  which is used to control ipesys clock output.
	  If you wish to use clock resources from the ipesys device,
	  say Y. Otherwise, say N.

config COMMON_CLK_MT6893_MDPSYS
	tristate "Clock driver for MediaTek MT6893 mdpsys"
	depends on COMMON_CLK_MT6893
	help
	  This driver supports MediaTek MT6893 mdpsys clocks,
	  which is used to control mdpsys clock output.
	  If you wish to use clock resources from the mdpsys device,
	  say Y. Otherwise, say N.

config COMMON_CLK_MT6893_MFGCFG
	tristate "Clock driver for MediaTek MT6893 mfgcfg"
	depends on COMMON_CLK_MT6893
	help
	  This driver supports MediaTek MT6893 mfgcfg clocks,
	  which is used to control mfgcfg clock output.
	  If you wish to use clock resources from the mfgcfg device,
	  say Y. Otherwise, say N.

config COMMON_CLK_MT6893_MMSYS
	tristate "Clock driver for MediaTek MT6893 mmsys"
	depends on COMMON_CLK_MT6893
	help
	  This driver supports MediaTek MT6893 mmsys clocks,
	  which is used to control mmsys clock output.
	  If you wish to use clock resources from the mmsys device,
	  say Y. Otherwise, say N.

config COMMON_CLK_MT6893_SCP_ADSP
	tristate "Clock driver for MediaTek MT6893 scp_adsp"
	depends on COMMON_CLK_MT6893
	help
	  This driver supports MediaTek MT6893 scp_adsp clocks,
	  which is used to control scp_adsp clock output.
	  If you wish to use clock resources from the scp_adsp device,
	  say Y. Otherwise, say N.

config COMMON_CLK_MT6893_VDECSYS
	tristate "Clock driver for MediaTek MT6893 vdecsys"
	depends on COMMON_CLK_MT6893
	help
	  This driver supports MediaTek MT6893 vdecsys clocks,
	  which is used to control vdecsys clock output.
	  If you wish to use clock resources from the vdecsys device,
	  say Y. Otherwise, say N.

config COMMON_CLK_MT6893_VDECSYS_SOC
	tristate "Clock driver for MediaTek MT6893 vdecsys_soc"
	depends on COMMON_CLK_MT6893
	help
	  This driver supports MediaTek MT6893 vdecsys_soc clocks,
	  which is used to control vdecsys_soc clock output.
	  If you wish to use clock resources from the vdecsys_soc device,
	  say Y. Otherwise, say N.

config COMMON_CLK_MT6893_VENCSYS_C1
	tristate "Clock driver for MediaTek MT6893 vencsys_c1"
	depends on COMMON_CLK_MT6893
	help
	  This driver supports MediaTek MT6893 vencsys_c1 clocks,
	  which is used to control vencsys_c1 clock output.
	  If you wish to use clock resources from the vencsys_c1 device,
	  say Y. Otherwise, say N.

config COMMON_CLK_MT6893_VENCSYS
	tristate "Clock driver for MediaTek MT6893 vencsys"
	depends on COMMON_CLK_MT6893
	help
	  This driver supports MediaTek MT6893 vencsys clocks,
	  which is used to control vencsys clock output.
	  If you wish to use clock resources from the vencsys device,
	  say Y. Otherwise, say N.

endmenu
```
