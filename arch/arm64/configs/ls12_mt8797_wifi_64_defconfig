## arch/arm64/configs/ls12_mt8797_wifi_64_defconfig
```kconfig
# CONFIG_LOCALVERSION_AUTO is not set
CONFIG_PREEMPT=y
CONFIG_IKHEADERS=m
CONFIG_LOG_BUF_SHIFT=23
CONFIG_UCLAMP_TASK=y
CONFIG_UCLAMP_TASK_GROUP=y
CONFIG_CPUSETS=y
# CONFIG_RD_BZIP2 is not set
# CONFIG_RD_LZMA is not set
# CONFIG_RD_XZ is not set
# CONFIG_RD_LZO is not set
# CONFIG_RD_LZ4 is not set
# CONFIG_FHANDLE is not set
# CONFIG_KALLSYMS_BASE_RELATIVE is not set
# CONFIG_SLUB_DEBUG is not set
CONFIG_ARCH_MEDIATEK=y
CONFIG_SCHED_MC=y
CONFIG_NR_CPUS=8
CONFIG_RANDOMIZE_BASE=y
CONFIG_CMDLINE="console=tty0 console=ttyMT3,921600n1 root=/dev/ram vmalloc=496M slub_max_order=0 slub_debug=O "
# CONFIG_EFI is not set
CONFIG_PM_DEBUG=y
CONFIG_WQ_POWER_EFFICIENT_DEFAULT=y
CONFIG_ENERGY_MODEL=y
CONFIG_CPU_FREQ=y
CONFIG_CPU_FREQ_STAT=y
CONFIG_CPU_FREQ_DEFAULT_GOV_SCHEDUTIL=y
CONFIG_CPU_FREQ_GOV_POWERSAVE=y
CONFIG_CPU_FREQ_GOV_USERSPACE=y
CONFIG_CPU_FREQ_GOV_ONDEMAND=y
CONFIG_MODULES=y
# CONFIG_MODULE_FORCE_LOAD is not set
CONFIG_MODULE_UNLOAD=y
# CONFIG_MODULE_FORCE_UNLOAD is not set
CONFIG_MODVERSIONS=y
CONFIG_MODULE_SRCVERSION_ALL=y
# CONFIG_MODULE_SIG is not set
# CONFIG_MODULE_COMPRESS is not set
# CONFIG_TRIM_UNUSED_KSYMS is not set
CONFIG_MODULES_TREE_LOOKUP=y
CONFIG_MODULES_USE_ELF_RELA=y
# CONFIG_BLK_DEV_BSG is not set
CONFIG_BLK_INLINE_ENCRYPTION=y
CONFIG_BLK_INLINE_ENCRYPTION_FALLBACK=y
# CONFIG_CORE_DUMP_DEFAULT_ELF_HEADERS is not set
CONFIG_ZSMALLOC=y
CONFIG_XFRM_MIGRATE=y
CONFIG_SYN_COOKIES=y
CONFIG_VLAN_8021Q=y
CONFIG_CLS_U32_PERF=y
CONFIG_CLS_U32_MARK=y
CONFIG_BT=y
CONFIG_CFG80211=y
CONFIG_NL80211_TESTMODE=y
CONFIG_CFG80211_DEVELOPER_WARNINGS=y
# CONFIG_CFG80211_DEFAULT_PS is not set
# CONFIG_UEVENT_HELPER is not set
# CONFIG_FW_CACHE is not set
CONFIG_ZRAM=y
CONFIG_BLK_DEV_LOOP_MIN_COUNT=16
CONFIG_NONLINEAR_FREQ_CTL=y
CONFIG_MTK_STATIC_POWER=y
CONFIG_MTK_APUSYS_SUPPORT=y
CONFIG_MTK_APUSYS_RT_SUPPORT=y
CONFIG_MTK_APUSYS_MDLA_SUPPORT=y
CONFIG_MTK_APUSYS_EDMA_SUPPORT=y
CONFIG_MTK_PTPOD_GPU=y
CONFIG_MTK_PBM=y
CONFIG_MFD_MT6360=y
CONFIG_CHARGER_MT6360=y
CONFIG_LEDS_MT6360=y
CONFIG_REGULATOR_MT6360=y
CONFIG_CUSTOM_KERNEL_IMGSENSOR="tsppk8a3288_gc08a3_mipi_raw tsppk8f3287_gc08a3_mipi_raw tsppkcf3290_gc13a0_mipi_raw"
#Begin by yongzhuo for LUSHAN-3 on 2023.07.01
CONFIG_DRM_PANEL_LUSHAN12_HX83121A_CDOT_CSOT_WITHOUT_VCOM_WQXGA_VDO=y
CONFIG_DRM_PANEL_LUSHAN12_HX83121A_CDOT_CSOT_WQXGA_VDO=y
CONFIG_AW3750X_POWER=y
#End by yongzhuo for LUSHAN-3 on 2023.07.01
CONFIG_MTK_AAL_SUPPORT=y
CONFIG_MTK_FLASHLIGHT=y
CONFIG_MTK_FLASHLIGHT_MT6360=y
CONFIG_MTK_FLASHLIGHT_PT=y
CONFIG_MTK_FLASHLIGHT_PT_STRICT=y
CONFIG_MTK_FLASHLIGHT_DLPT=y
CONFIG_MTK_IMGSENSOR=y
CONFIG_MTK_LENS=y
CONFIG_MTK_CAM_CAL=y
CONFIG_MTK_CMDQ=y
CONFIG_MTK_CMDQ_MBOX_EXT=y
CONFIG_MTK_VPU_SUPPORT=y
CONFIG_MTK_JPEG=y
CONFIG_MTK_CCU=y
CONFIG_MTK_SENSOR_SUPPORT=y
CONFIG_CUSTOM_KERNEL_SENSORHUB=y
CONFIG_NANOHUB=y
CONFIG_NANOHUB_MTK_IPI=y
#Begin modify by xiakang.chen for hallkey on 2023/8/1
CONFIG_HALL_KEY_SWITCH=y
#End modify by xiakang.chen for hallkey on 2023/8/1
CONFIG_MTK_BTIF=y
CONFIG_MTK_COMBO=y
CONFIG_MTK_COMBO_CHIP_CONSYS_6893=y
CONFIG_MTK_COMBO_BT=y
CONFIG_MTK_COMBO_WIFI=y
CONFIG_MTK_WIFI_MCC_SUPPORT=y
CONFIG_MTK_DHCPV6C_WIFI=y
CONFIG_MTK_FMRADIO=y
CONFIG_MTK_FM_CHIP="MT6635_FM"
CONFIG_MTK_CONNSYS_DEDICATED_LOG_PATH=y
# Begin: 官核 orig_ikconfig 反编译对齐（2026-08-12）
CONFIG_MTK_CQDMA=y
CONFIG_MTK_DRAMC=y
CONFIG_MTK_CHARGER_TYPE_DETECT=y
CONFIG_MTK_AEE_AED=y
CONFIG_MTK_AEE_FEATURE=y
CONFIG_MTK_AEE_IPANIC=y
CONFIG_MTK_AMMS=y
CONFIG_MTK_APUSYS_VPU=y
CONFIG_MTK_ATF_LOGGER=y
CONFIG_MTK_AUDIO_IPI=y
CONFIG_MTK_CACHE_PARITY_CHECK=y
CONFIG_MTK_CMDQ_MBOX=y
CONFIG_MTK_COMBO_PLAT_PATH=""
CONFIG_MTK_DBGTOP=y
CONFIG_MTK_DEVAPC=y
CONFIG_MTK_DEVMPU=y
CONFIG_MTK_GZ_KREE=y
CONFIG_MTK_HANG_DETECT=y
CONFIG_MTK_HANG_DETECT_DB=y
CONFIG_MTK_LOW_POWER_MODULE=y
CONFIG_MTK_LPM_MT6893=y
CONFIG_MTK_LPM_DBG_COMMON=y
CONFIG_MTK_LPM_GS_DUMP_SUPPORT=y
CONFIG_MTK_LPM_GS_DUMP_VERSION="v1"
CONFIG_MTK_LPM_MODULE_NAME="mt6885"
CONFIG_MTK_LPM_MT6885=y
CONFIG_MTK_MMPROFILE_SUPPORT=y
CONFIG_MTK_PERFORMANCE_MODULE=y
CONFIG_MTK_PID_MAP=y
CONFIG_MTK_PROT_MEM_SUPPORT=y
CONFIG_MTK_QOS_FRAMEWORK=y
CONFIG_MTK_ROUND_CORNER_SUPPORT=y
CONFIG_MTK_SCPSYS=y
CONFIG_MTK_SECURITY_SW_SUPPORT=y
CONFIG_MTK_SLBC=y
CONFIG_MTK_SMI=y
CONFIG_MTK_SOCINFO=y
CONFIG_MTK_THERMAL=y
CONFIG_MTK_TIMER=y
CONFIG_MTK_TINYSYS_SCP_LOGGER_SUPPORT=y
CONFIG_MTK_TRUSTED_MEMORY_SUBSYSTEM=y
CONFIG_MTK_USB_TYPEC=y
CONFIG_PHY_MTK_UFS=y
CONFIG_PINCTRL_MTK_PARIS=y
CONFIG_PINCTRL_MTK_V2=y
CONFIG_PINCTRL_MT6885=y
CONFIG_EINT_MTK=y
# 以下 pinctrl 因 Kconfig 里 "default ARM64 && ARCH_MEDIATEK" 或 "default MFD_MT6397"
# 会被静默启用，且其代码内嵌 5.10 已删除的 struct mtk_eint_hw（4.19 残留），编译必挂：
#   - 旧 common 框架（select PINCTRL_MTK，头 pinctrl-mtk-common.h 内嵌）：MT2712/MT6397/MT8167/MT8173/MT8516
#   - driver 自身内嵌 mtk_eint_hw：MT7622(pinctrl-mt7622.c)/MT8183(pinctrl-mt8183.c)/MT8192(pinctrl-mt8192.c)
#   另有 MT6779/MT6797 走 PARIS 无此残留，但非 ls12(mt6885) 目标，一并关闭。
# ls12 只用 PARIS 框架的 pinctrl-mt6885.c + mtk-eint.c（5.10 新结构，无 mtk_eint_hw）。
# CONFIG_PINCTRL_MT2712 is not set
# CONFIG_PINCTRL_MT6397 is not set
# CONFIG_PINCTRL_MT6779 is not set
# CONFIG_PINCTRL_MT6797 is not set
# CONFIG_PINCTRL_MT7622 is not set
# CONFIG_PINCTRL_MT8167 is not set
# CONFIG_PINCTRL_MT8173 is not set
# CONFIG_PINCTRL_MT8183 is not set
# CONFIG_PINCTRL_MT8192 is not set
# CONFIG_PINCTRL_MT8516 is not set
CONFIG_SND_SOC_MT6359=y
CONFIG_SND_SOC_MT6885=y
CONFIG_SND_SOC_MTK_SMART_PHONE=y
CONFIG_SND_SOC_MTK_SRAM=y
CONFIG_THERMAL_EMERGENCY_POWEROFF_DELAY_MS=0
CONFIG_THERMAL_OF=y
CONFIG_TOUCHSCREEN_MTK_TOUCH=""
CONFIG_TOUCHSCREEN_PROPERTIES=y
CONFIG_WATCHDOG_HANDLE_BOOT_ENABLED=y
# End: 官核 orig_ikconfig 反编译对齐
CONFIG_HAVE_MTK_ENABLE_GENIEZONE=y
CONFIG_MTK_ENABLE_GENIEZONE=y
CONFIG_MTK_GZ_MAIN=y
CONFIG_MTK_GZ_LOG=y
CONFIG_MTK_GZ_VIRTIO=y
CONFIG_MTK_GZ_VIRTIO_IPC=y
CONFIG_MTK_GZ_IRQ=y
CONFIG_HAVE_MTK_GZ_LOG=y
CONFIG_EXTCON_MTK_USB=y
#begin add by wenhaodeng for task LUSHAN-102 on 20230803
#CONFIG_MTK_USB_TYPEC_DP_MUX_V2=y
CONFIG_MTK_USB_TYPEC_DP_MUX=y
#end add by wenhaodeng for task LUSHAN-102 on 20230803
#Begin modify by lanying.he for typec headset on 2023/7/11
#CONFIG_OCP96011_I2C=y
CONFIG_TCT_MT6359_FSA4480=y
CONFIG_TCT_DEVICEINFO=y
#End modify by lanying.he for typec headset on 2023/7/11
CONFIG_TCPC_CLASS=y
CONFIG_TCPC_MT6360=y
CONFIG_USB_POWER_DELIVERY=y
CONFIG_MTK_TYPEC_WATER_DETECT=y
CONFIG_MTK_TYPEC_WATER_DETECT_BY_PCB=y
CONFIG_LEDS_MTK=y
#CONFIG_LEDS_MTK_DISP=y
CONFIG_LEDS_MTK_PWM=y
CONFIG_MTK_PWM=y
CONFIG_SND_SOC_MT6359P_ACCDET=y
#Begin modify by lanying.he for typec headset on 2023/7/11
#CONFIG_ACCDET_EINT_IRQ=y
#CONFIG_ACCDET_SUPPORT_EINT0=y
#End modify by lanying.he for typec headset on 2023/7/11
CONFIG_MTK_PERF_COMMON=y
CONFIG_MTK_PERF_TRACKER=y
CONFIG_MTK_CORE_CTL=y
CONFIG_MTK_LOAD_TRACKER=y
CONFIG_MTK_FPSGO_V3=y
CONFIG_MTK_TASK_TURBO=y
CONFIG_MTK_TINYSYS_SCP_SUPPORT=y
CONFIG_MTK_TINYSYS_SSPM_SUPPORT=y
CONFIG_MTK_TINYSYS_SSPM_V2=y

CONFIG_MTPROF=y
CONFIG_MTK_AEE_HANGDET=y
CONFIG_MTK_SLBC_MMSRAM=y
CONFIG_MTK_CM_MGR=y
CONFIG_MTK_CM_MGR_LEGACY=y
CONFIG_MTK_TINYSYS_MCUPM_SUPPORT=y
CONFIG_MTK_DRAM_LOG_STORE=y
CONFIG_MTK_DRAM_LOG_STORE_ADDR=0x0011DF00
CONFIG_MTK_DRAM_LOG_STORE_SIZE=0x100
CONFIG_MTK_VOW_SUPPORT=y
CONFIG_MTK_VOW_DUAL_MIC_SUPPORT=y
CONFIG_MTK_VOW_MAX_PDK_NUMBER=2
CONFIG_MTK_VOW_DSP_VERSION="ver02"
CONFIG_COMMON_CLK_MTK_FREQ_HOPPING=y
CONFIG_SCSI=y
CONFIG_BLK_DEV_SD=y
CONFIG_SCSI_SCAN_ASYNC=y
CONFIG_SCSI_UFSHCD=y
CONFIG_SCSI_UFSHCD_PLATFORM=y
CONFIG_SCSI_UFS_MEDIATEK=y
CONFIG_SCSI_UFS_HPB=y
CONFIG_SCSI_UFS_CRYPTO=y
CONFIG_DM_CRYPT=y
CONFIG_DM_DEFAULT_KEY=y
CONFIG_DM_UEVENT=y
CONFIG_DM_VERITY_FEC=y
CONFIG_IFB=y
# CONFIG_ETHERNET is not set
CONFIG_PPP_FILTER=y
CONFIG_PPP_MULTILINK=y
CONFIG_PPPOE=y
CONFIG_PPP_ASYNC=y
CONFIG_PPP_SYNC_TTY=y
CONFIG_USB_USBNET=y
# CONFIG_KEYBOARD_ATKBD is not set
CONFIG_KEYBOARD_MTK_PMIC=y
# CONFIG_INPUT_MOUSE is not set
CONFIG_INPUT_TOUCHSCREEN=y
#Begin by yongzhuo for LUSHAN-4 on 2023.07.03
CONFIG_TOUCHSCREEN_LUSHAN12_HX83121A_SPI=y
CONFIG_TOUCHSCREEN_HIMAX_CHIPSET=y
CONFIG_TOUCHSCREEN_HIMAX_COMMON=y
CONFIG_TOUCHSCREEN_HIMAX_IC_HX83121A=y
CONFIG_TOUCHSCREEN_HIMAX_DEBUG=y
CONFIG_TOUCHSCREEN_HIMAX_INSPECT=y
#CONFIG_TOUCHSCREEN_MTK=y
#CONFIG_TOUCHSCREEN_GOODIX_BRL=y
#CONFIG_TOUCHSCREEN_GOODIX_BRL_SPI=y
#End by yongzhuo for LUSHAN-4 on 2023.07.03
CONFIG_INPUT_MISC=y
CONFIG_INPUT_UINPUT=y
# CONFIG_SERIO is not set
# CONFIG_VT is not set
CONFIG_LEGACY_PTY_COUNT=16
# CONFIG_DEVMEM is not set
CONFIG_SERIAL_8250=y
CONFIG_SERIAL_8250_CONSOLE=y
CONFIG_SERIAL_8250_NR_UARTS=2
CONFIG_SERIAL_8250_RUNTIME_UARTS=2
CONFIG_SERIAL_8250_MT6577=y
CONFIG_I2C=y
CONFIG_I2C_MT65XX=y
CONFIG_SPI=y
CONFIG_SPI_MT65XX=y
CONFIG_SPMI=y
CONFIG_SPMI_MTK_PMIF=y
CONFIG_MTK_PUMP_EXPRESS_PLUS_SUPPORT=y
CONFIG_MTK_PUMP_EXPRESS_PLUS_20_SUPPORT=y
CONFIG_MTK_PUMP_EXPRESS_50_SUPPORT=y
CONFIG_CHARGER_SC856X=y
CONFIG_MTK_CHARGER=y
# CONFIG_HWMON is not set
CONFIG_THERMAL=y
CONFIG_WATCHDOG=y
CONFIG_MEDIATEK_WATCHDOG=y
CONFIG_MFD_MT6397=y
CONFIG_MFD_MTK_SPMI_PMIC=y
CONFIG_REGULATOR_MT6315=y
CONFIG_REGULATOR_MT6359P=y
CONFIG_MEDIA_SUPPORT=y
CONFIG_MEDIA_CAMERA_SUPPORT=y
CONFIG_V4L_PLATFORM_DRIVERS=y
CONFIG_V4L_MEM2MEM_DRIVERS=y
CONFIG_VIDEO_MEDIATEK_JPEG=y
CONFIG_VIDEO_MEDIATEK_VCODEC=y
CONFIG_DRM=y
CONFIG_DRM_MIPI_DSI=y
CONFIG_DRM_KMS_HELPER=y
CONFIG_DRM_KMS_FB_HELPER=y
CONFIG_DRM_FBDEV_EMULATION=y
CONFIG_DRM_FBDEV_OVERALLOC=100
CONFIG_DRM_PANEL=y
CONFIG_DRM_PANEL_ORIENTATION_QUIRKS=y
#CONFIG_DRM_PANEL_RAYDIUM_RM692H0=y
CONFIG_DRM_MEDIATEK=y
CONFIG_DRM_BRIDGE=y
CONFIG_DRM_PANEL_BRIDGE=y
CONFIG_MTK_GPU_SUPPORT=y
CONFIG_MTK_GPU_VERSION="mali valhall r32p1"
CONFIG_MTK_GPU_COMMON_DVFS_SUPPORT=y
CONFIG_FB=y
CONFIG_FB_CMDLINE=y
CONFIG_FB_NOTIFY=y
CONFIG_FB_CFB_FILLRECT=y
CONFIG_FB_CFB_COPYAREA=y
CONFIG_FB_CFB_IMAGEBLIT=y
CONFIG_FB_SYS_FILLRECT=y
CONFIG_FB_SYS_COPYAREA=y
CONFIG_FB_SYS_IMAGEBLIT=y
CONFIG_FB_SYS_FOPS=y
CONFIG_FB_DEFERRED_IO=y
CONFIG_FB_MODE_HELPERS=y
CONFIG_FB_TILEBLITTING=y
CONFIG_BACKLIGHT_CLASS_DEVICE=y
CONFIG_LOGO=y
CONFIG_SND_HRTIMER=y
CONFIG_SND_DYNAMIC_MINORS=y
CONFIG_SND_VERBOSE_PRINTK=y
CONFIG_SND_DEBUG=y
CONFIG_SND_DEBUG_VERBOSE=y
CONFIG_SND_PCM_XRUN_DEBUG=y
CONFIG_SND_SEQUENCER=y
CONFIG_SND_SEQ_DUMMY=y
CONFIG_TCT_ES7210=y
# CONFIG_SND_SPI is not set
CONFIG_SND_USB_AUDIO=y
CONFIG_SND_SOC=y
CONFIG_SND_SOC_MT6885_MT6359P=y
CONFIG_SND_SOC_MTK_BTCVSD=y
CONFIG_MTK_VOW_BARGE_IN_SUPPORT=y
#Begin modify by lanying.he for aw88394 bringup
CONFIG_TCT_SMARTPA_AW883XX=y
#CONFIG_SND_SOC_ES7243E=y
#CONFIG_SND_SOC_TFA9874=y
#CONFIG_SND_SOC_CS35L43=y
#End modify by lanying.he for aw88394 bringup
CONFIG_HIDRAW=y
CONFIG_HID_A4TECH=y
CONFIG_HID_APPLE=y
CONFIG_HID_BELKIN=y
CONFIG_HID_CHERRY=y
CONFIG_HID_CHICONY=y
CONFIG_HID_CYPRESS=y
CONFIG_HID_DRAGONRISE=y
CONFIG_HID_EZKEY=y
CONFIG_HID_KYE=y
CONFIG_HID_GYRATION=y
CONFIG_HID_TWINHAN=y
CONFIG_HID_KENSINGTON=y
CONFIG_HID_LOGITECH=y
CONFIG_HID_MAGICMOUSE=y
CONFIG_HID_MICROSOFT=y
CONFIG_HID_MONTEREY=y
CONFIG_HID_PANTHERLORD=y
CONFIG_HID_PETALYNX=y
CONFIG_HID_SAMSUNG=y
CONFIG_SONY_FF=y
CONFIG_HID_SUNPLUS=y
CONFIG_HID_GREENASIA=y
CONFIG_HID_SMARTJOYPLUS=y
CONFIG_HID_TOPSEED=y
CONFIG_HID_THRUSTMASTER=y
CONFIG_HID_ZEROPLUS=y
CONFIG_USB_OTG=y
CONFIG_USB_XHCI_HCD=y
CONFIG_USB_STORAGE=y
CONFIG_USB_STORAGE_DATAFAB=y
CONFIG_USB_STORAGE_FREECOM=y
CONFIG_USB_STORAGE_ISD200=y
CONFIG_USB_STORAGE_USBAT=y
CONFIG_USB_STORAGE_SDDR09=y
CONFIG_USB_STORAGE_SDDR55=y
CONFIG_USB_STORAGE_JUMPSHOT=y
CONFIG_USB_STORAGE_ALAUDA=y
CONFIG_USB_STORAGE_ONETOUCH=y
CONFIG_USB_STORAGE_KARMA=y
CONFIG_USB_STORAGE_CYPRESS_ATACB=y
CONFIG_USB_MTU3=y
CONFIG_USB_TRANCEVIBRATOR=y
CONFIG_NOP_USB_XCEIV=y
CONFIG_USB_GADGET_VBUS_DRAW=500
CONFIG_USB_CONFIGFS_SERIAL=y
CONFIG_USB_CONFIGFS_ACM=y
CONFIG_USB_CONFIGFS_RNDIS=y
CONFIG_USB_CONFIGFS_MASS_STORAGE=y
CONFIG_USB_CONFIGFS_F_HID=y
CONFIG_MMC=y
CONFIG_MMC_BLOCK_MINORS=32
CONFIG_MMC_CRYPTO=y
CONFIG_MMC_CQHCI=y
CONFIG_MMC_MTK=y
CONFIG_NEW_LEDS=y
CONFIG_LEDS_CLASS=y
CONFIG_LEDS_CLASS_FLASH=y
CONFIG_LEDS_REGULATOR_VIBRATOR=y
CONFIG_LEDS_TRIGGERS=y
CONFIG_LEDS_TRIGGER_TIMER=y
# CONFIG_RTC_SYSTOHC is not set
CONFIG_RTC_DRV_MT6397=y
CONFIG_DMADEVICES=y
CONFIG_MTK_UART_APDMA=y
CONFIG_ION=y
CONFIG_COMMON_CLK_MT6893=y
CONFIG_COMMON_CLK_MT6893_APU0=y
CONFIG_COMMON_CLK_MT6893_AUDIOSYS=y
CONFIG_COMMON_CLK_MT6893_CAMSYS_MAIN=y
CONFIG_COMMON_CLK_MT6893_IMGSYS1=y
CONFIG_COMMON_CLK_MT6893_IMP_IIC_WRAP_C=y
CONFIG_COMMON_CLK_MT6893_IPESYS=y
CONFIG_COMMON_CLK_MT6893_MDPSYS=y
CONFIG_COMMON_CLK_MT6893_MFGCFG=y
CONFIG_COMMON_CLK_MT6893_MMSYS=y
CONFIG_COMMON_CLK_MT6893_SCP_ADSP=y
CONFIG_COMMON_CLK_MT6893_VDECSYS=y
CONFIG_COMMON_CLK_MT6893_VENCSYS=y
CONFIG_MTK_IOMMU=y
CONFIG_RPMSG_MTK=y
CONFIG_MTK_PMIC_WRAP=y
CONFIG_MTK_IPI=y
CONFIG_MTK_MBOX=y
CONFIG_IIO=y
CONFIG_IIO_BUFFER=y
CONFIG_IIO_KFIFO_BUF=y
CONFIG_MEDIATEK_MT6577_AUXADC=y
CONFIG_MEDIATEK_MT635X_AUXADC=y
CONFIG_PWM=y
CONFIG_PWM_MTK_DISP=y
CONFIG_PHY_MTK_TPHY=y
CONFIG_MTK_DEVINFO=y
CONFIG_FS_ENCRYPTION_INLINE_CRYPT=y
CONFIG_QUOTA_NETLINK_INTERFACE=y
CONFIG_INCREMENTAL_FS=y
CONFIG_ISO9660_FS=y
CONFIG_JOLIET=y
CONFIG_ZISOFS=y
CONFIG_MSDOS_FS=y
CONFIG_VFAT_FS=y
CONFIG_PSTORE=y
CONFIG_PSTORE_CONSOLE=y
CONFIG_PSTORE_PMSG=y
CONFIG_PSTORE_RAM=y
# CONFIG_NETWORK_FILESYSTEMS is not set
CONFIG_NLS_CODEPAGE_437=y
CONFIG_NLS_CODEPAGE_950=y
CONFIG_NLS_ASCII=y
CONFIG_NLS_ISO8859_1=y
CONFIG_NLS_UTF8=y
CONFIG_STATIC_USERMODEHELPER=y
CONFIG_STATIC_USERMODEHELPER_PATH="/system_ext/bin/aee_core_forwarder"
# CONFIG_SECURITY_SELINUX_DEVELOP is not set
CONFIG_CRYPTO_TWOFISH=y
# CONFIG_CRYPTO_HW is not set
CONFIG_CRC8=y
CONFIG_PRINTK_TIME=y
CONFIG_DYNAMIC_DEBUG=y
CONFIG_DEBUG_INFO=y
CONFIG_FRAME_WARN=3600
CONFIG_PANIC_ON_OOPS=y
CONFIG_PANIC_TIMEOUT=1
CONFIG_SCHEDSTATS=y
# CONFIG_DEBUG_PREEMPT is not set
# CONFIG_DEBUG_BUGVERBOSE is not set
CONFIG_RCU_CPU_STALL_TIMEOUT=60
CONFIG_FAULT_INJECTION=y
CONFIG_ENABLE_DEFAULT_TRACERS=y
# 补齐 4 项 AND-depends 父符号（音频 ipi / 调度 core_ctl / 频控 nonlinear / USB dp mux，2026-08-26）
CONFIG_MTK_AUDIODSP_SUPPORT=y
CONFIG_MTK_SCHEDULER=y
CONFIG_MTK_CORE_PAUSE=y
CONFIG_MTK_CPUFREQ_SUGOV_EXT=y
CONFIG_MTK_OPP_CAP_INFO=y
CONFIG_MTK_USB_TYPEC_MUX=y
```
